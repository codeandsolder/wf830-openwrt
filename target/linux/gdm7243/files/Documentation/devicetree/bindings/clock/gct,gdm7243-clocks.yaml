## target/linux/gdm7243/files/Documentation/devicetree/bindings/clock/gct,gdm7243-clocks.yaml
```yaml
# SPDX-License-Identifier: (GPL-2.0-only OR BSD-2-Clause)
%YAML 1.2
---
$id: http://devicetree.org/schemas/clock/gct,gdm7243-clocks.yaml#
$schema: http://devicetree.org/meta-schemas/core.yaml#

title: GCT GDM7243QT application-CPU clock controller

maintainers:
  - codeandsolder <codeandsolder@gmail.com>

description: |
  Five root clocks and 27 peripheral entries. Root rates are derived
  from bootloader-provided strap and PLL values. All original gate
  bits are represented, including zero-rate peripherals whose parent
  clocks have not yet been identified.
  IDs are defined in dt-bindings/clock/gct,gdm7243.h.

properties:
  compatible:
    const: gct,gdm7243-clocks

  reg:
    maxItems: 1
    description: |
      SoC clock/power configuration register block including gate
      registers at offsets 0x40c, 0x438 and 0x43c and transaction
      lock registers at 0x10 and 0x18. At least 0x490 bytes.

  '#clock-cells':
    const: 1

required:
  - compatible
  - reg
  - '#clock-cells'

additionalProperties: false

examples:
  - |
    clock-controller@fc000000 {
        compatible = "gct,gdm7243-clocks";
        reg = <0xfc000000 0x500>;
        #clock-cells = <1>;
    };
...
```

## target/linux/gdm7243/files/Documentation/devicetree/bindings/gpio/gct,gdm7243-gpio.yaml
```yaml
# SPDX-License-Identifier: (GPL-2.0-only OR BSD-2-Clause)
%YAML 1.2
---
$id: http://devicetree.org/schemas/gpio/gct,gdm7243-gpio.yaml#
$schema: http://devicetree.org/meta-schemas/core.yaml#

title: GCT GDM7243 application-CPU banked GPIO controller

maintainers:
  - codeandsolder <codeandsolder@gmail.com>

description: |
  A set of 32-bit GPIO banks with direction at 0xfc002080 + bank*4
  and input/output data at 0xfc0020c0 + bank*4. The vendor kernel
  represents each pin as (bank << 8) | bit, with bit in [0, 31].
  Modern Linux uses contiguous GPIO offsets bank*32 + bit instead.
  The direction/data arrays can address at most 16 banks before
  the next register group. The vendor GPIO interrupt helpers support
  only banks 0 through 6. Two independently maskable interrupt channels
  share mode and polarity registers; their bank-level summaries, masks,
  and pending bits occupy later registers in the same MMIO aperture.
  Each GPIO IRQ line is bound to exactly one interrupt channel by
  the fixed board routing property gct,irq1-mask.

properties:
  compatible:
    const: gct,gdm7243-gpio

  reg:
    maxItems: 1

  interrupts:
    minItems: 2
    maxItems: 2

  interrupt-names:
    items:
      - const: gpio0
      - const: gpio1

  interrupt-controller: true

  '#interrupt-cells':
    const: 2

  gct,irq1-mask:
    description: |
      Seven 32-bit words, one per interrupt-capable GPIO bank (0-6).
      A set bit routes that pin's interrupt to GPIO1 (parent IRQ 29);
      a clear bit routes it to GPIO0 (parent IRQ 10). This fixes the
      route for the lifetime of the GPIO chip; no hardware route mux
      is required because each pin has separate enable masks for both
      channels.
    minItems: 7
    maxItems: 7
    items:
      minimum: 0
      maximum: 4294967295

  gpio-controller: true

  '#gpio-cells':
    const: 2

  gpio-ranges:
    maxItems: 1
    description: |
      All 224 IRQ-capable pinctrl offsets map identically to GPIO
      offsets 0..223. Unbonded or unsupported pins must additionally
      be excluded using gpio-reserved-ranges.

  ngpios:
    minimum: 1
    maximum: 512
    description: >
      Number of populated GPIO lines, including any reserved holes.
      The physical pins and absent lines must be determined by board
      pad/pinmux data.

required:
  - compatible
  - reg
  - gpio-controller
  - '#gpio-cells'
  - ngpios
  - interrupts
  - interrupt-names
  - interrupt-controller
  - '#interrupt-cells'

allOf:
  - $ref: /schemas/gpio/gpio.yaml#

unevaluatedProperties: false

examples:
  - |
    gpio@fc002080 {
        compatible = "gct,gdm7243-gpio";
        reg = <0xfc002080 0x320>;
        interrupts = <10>, <29>;
        interrupt-names = "gpio0", "gpio1";
        gpio-controller;
        #gpio-cells = <2>;
        interrupt-controller;
        #interrupt-cells = <2>;
        ngpios = <224>;
        gct,irq1-mask = <0 0 0 0 0 0 0>;
    };
...
```

## target/linux/gdm7243/files/Documentation/devicetree/bindings/interrupt-controller/gct,gdm7243-intc.yaml
```yaml
# SPDX-License-Identifier: (GPL-2.0-only OR BSD-2-Clause)
%YAML 1.2
---
$id: http://devicetree.org/schemas/interrupt-controller/gct,gdm7243-intc.yaml#
$schema: http://devicetree.org/meta-schemas/core.yaml#

title: GCT GDM7243 integrated interrupt controller

maintainers:
  - codeandsolder <codeandsolder@gmail.com>

description: |
  The GDM7243QT application processor has a root controller for 64
  level-triggered sources in two 32-bit banks. Hardware IRQ 19 was
  explicitly excluded by the OEM kernel. The register block is
  memory-mapped at 0xfc002c00.

properties:
  compatible:
    const: gct,gdm7243-intc

  reg:
    maxItems: 1

  interrupt-controller: true

  '#interrupt-cells':
    const: 1

required:
  - compatible
  - reg
  - interrupt-controller
  - '#interrupt-cells'

additionalProperties: false

examples:
  - |
    interrupt-controller@fc002c00 {
        compatible = "gct,gdm7243-intc";
        reg = <0xfc002c00 0x60>;
        interrupt-controller;
        #interrupt-cells = <1>;
    };
...
```

## target/linux/gdm7243/files/Documentation/devicetree/bindings/pinctrl/gct,gdm7243-pinctrl.yaml
```yaml
# SPDX-License-Identifier: (GPL-2.0-only OR BSD-2-Clause)
%YAML 1.2
---
$id: http://devicetree.org/schemas/pinctrl/gct,gdm7243-pinctrl.yaml#
$schema: http://devicetree.org/meta-schemas/core.yaml#

title: GCT GDM7243QT seven-bank pin mux controller

maintainers:
  - codeandsolder <codeandsolder@gmail.com>

description: |
  The application CPU has 63 OEM pin mux groups spanning 131
  documented pads in seven 32-pin banks. Selector words occupy
  consecutive physical addresses 0xfc000500 through 0xfc000518.
  Pin numbers use normal GPIO offsets (bank * 32 + pin).
  Some independently named groups share physical mux fields,
  notably GPE 0-10 and 12-15; they must select compatible
  modes and are arbitrated by the driver.
  Peripheral pad configuration (pulls, drive strength, etc.)
  is not described by the available source material.

properties:
  compatible:
    const: gct,gdm7243-pinctrl

  reg:
    maxItems: 1

patternProperties:
  '-pins$':
    type: object
    additionalProperties: false

    properties:
      function:
        enum:
          - anfc
          - ant-sw
          - ant-swb
          - arm0-trace
          - arm1-trace
          - clk-out
          - ds
          - gnfc
          - gpio
          - i2c
          - i2s
          - jtag
          - jtag-arm-rtck
          - keypad
          - lna
          - lte-tp
          - mii
          - pa-mode
          - pa1-pe
          - pa2-pe
          - pcm
          - reset-out
          - rffe
          - rgmii
          - rmii
          - sddev
          - sdhost
          - sdhost1
          - spi
          - spi-cs1
          - spi-cs2
          - spi-cs3
          - tr-sw
          - tr-swb
          - uart0
          - uart1
          - uart2
          - uart3
          - ulpi-dev
          - ulpi-host
          - usim
          - wb-tp
      groups:
        $ref: /schemas/types.yaml#/definitions/string-array
        minItems: 1
        maxItems: 63
        uniqueItems: true
        items:
          enum:
            - gpa-0
            - gpa-1
            - gpa-2
            - gpa-3-6
            - gpa-7
            - gpb-0-13
            - gpc-0-3
            - gpc-4-7
            - gpc-8-9
            - gpc-10
            - gpc-11
            - gpc-12
            - gpc-13-15
            - gpc-16
            - gpd-0-3
            - gpd-4-7
            - gpd-8-9
            - gpd-10
            - gpd-11
            - gpd-12-13
            - gpd-14-15
            - gpd-16-17
            - gpd-18-23
            - gpe-0-10
            - gpe-11
            - gpe-12-15
            - gpe-16
            - gpf-0
            - gpf-1
            - gpf-2
            - gpf-3
            - gpf-4
            - gpf-5
            - gpf-6
            - gpf-7
            - gpf-8
            - gpf-9
            - gpf-10
            - gpf-11
            - gpf-12
            - gpf-13
            - gpf-14
            - gpf-15
            - gpf-16
            - gpf-17
            - gpf-18
            - gpf-19
            - gpf-20
            - gpf-21
            - gpf-22-23
            - gpg-0-3
            - gpg-4
            - gpg-5
            - gpg-6
            - gpg-7-8
            - gpg-9-10
            - gpg-11-12
            - gpg-13-14
            - gpg-15
            - gpg-16-18
            - gpg-19-22
            - gpg-23-24
            - gpg-25-26

    required:
      - function
      - groups

allOf:
  - $ref: pinctrl.yaml#

required:
  - compatible
  - reg

unevaluatedProperties: false

examples:
  - |
    pinctrl: pinctrl@fc000500 {
        compatible = "gct,gdm7243-pinctrl";
        reg = <0xfc000500 0x1c>;

        uart0-pins {
            function = "uart0";
            groups = "gpg-9-10";
        };

        ethernet-pins {
            function = "rgmii";
            groups = "gpe-0-10", "gpe-12-15";
        };
    };
...
```

## target/linux/gdm7243/files/Documentation/devicetree/bindings/serial/gct,gdm7243-uart.yaml
```yaml
# SPDX-License-Identifier: (GPL-2.0-only OR BSD-2-Clause)
%YAML 1.2
---
$id: http://devicetree.org/schemas/serial/gct,gdm7243-uart.yaml#
$schema: http://devicetree.org/meta-schemas/core.yaml#

title: GCT GDM7243 application CPU UART0-2

maintainers:
  - codeandsolder <codeandsolder@gmail.com>

description: |
  The application processor has three UARTs sharing the same register
  layout, with TX at offset 0 and TX_FULL at status offset 0x14 bit 2.
  A fourth UART has a different register layout and is not compatible.
  The early console relies on the bootloader setting baud and clock.
  The full serial driver supports receive, transmit, error flags,
  framing, baud programming and a normal console. UART3 is separate.
  GPIO-based RTS/CTS requires board-specific pad-mux integration.

properties:
  compatible:
    const: gct,gdm7243-uart

  reg:
    maxItems: 1

  interrupts:
    minItems: 2
    maxItems: 2
    description: Receive and transmit interrupt lines, respectively

  interrupt-names:
    items:
      - const: rx
      - const: tx

  clocks:
    maxItems: 1

required:
  - compatible
  - reg
  - interrupts
  - interrupt-names
  - clocks

additionalProperties: false

examples:
  - |
    clocks: clock-controller@fc000000 {
        compatible = "gct,gdm7243-clocks";
        reg = <0xfc000000 0x500>;
        #clock-cells = <1>;
    };

    serial@fc007500 {
        compatible = "gct,gdm7243-uart";
        reg = <0xfc007500 0x40>;
        interrupts = <2>, <3>;
        interrupt-names = "rx", "tx";
        clocks = <&clocks 8>;
    };
...
```

## target/linux/gdm7243/files/Documentation/devicetree/bindings/timer/gct,gdm7243-rtccs.yaml
```yaml
# SPDX-License-Identifier: (GPL-2.0-only OR BSD-2-Clause)
%YAML 1.2
---
$id: http://devicetree.org/schemas/timer/gct,gdm7243-rtccs.yaml#
$schema: http://devicetree.org/meta-schemas/core.yaml#

title: GCT GDM7243 always-on 32.768 kHz RTC counter

maintainers:
  - codeandsolder <codeandsolder@gmail.com>

description: |
  The GDM7243QT integrates an always-on 32-bit count-up register at
  physical 0xfc000604, clocked by a 32.768 kHz oscillator. The stock
  Polish P4 kernel uses it as sched_clock and the "rtccs" clocksource.
  It is not the separate interrupt-generating system tick timer.

properties:
  compatible:
    const: gct,gdm7243-rtccs

  reg:
    maxItems: 1

  clock-frequency:
    const: 32768

required:
  - compatible
  - reg
  - clock-frequency

additionalProperties: false

examples:
  - |
    timer@fc000600 {
        compatible = "gct,gdm7243-rtccs";
        reg = <0xfc000600 0x20>;
        clock-frequency = <32768>;
    };
...
```

## target/linux/gdm7243/files/Documentation/devicetree/bindings/timer/gct,gdm7243-timer.yaml
```yaml
# SPDX-License-Identifier: (GPL-2.0-only OR BSD-2-Clause)
%YAML 1.2
---
$id: http://devicetree.org/schemas/timer/gct,gdm7243-timer.yaml#
$schema: http://devicetree.org/meta-schemas/core.yaml#

title: GCT GDM7243QT periodic system timer

maintainers:
  - codeandsolder <codeandsolder@gmail.com>

description: |
  The application processor's timer consists of a reload word at
  offset 0 and a control word at offset 0x10. The Polish P4 kernel
  uses hardware interrupt 18 to deliver periodic ticks. Its timer
  clock is obtained from the SoC clock tree, not presumed constant.
  The existing firmware only implements periodic mode.

properties:
  compatible:
    const: gct,gdm7243-timer

  reg:
    maxItems: 1

  interrupts:
    maxItems: 1

  clocks:
    maxItems: 1

required:
  - compatible
  - reg
  - interrupts
  - clocks

additionalProperties: false

examples:
  - |
    clocks: clock-controller@fc000000 {
        compatible = "gct,gdm7243-clocks";
        reg = <0xfc000000 0x500>;
        #clock-cells = <1>;
    };

    timer@fc006c40 {
        compatible = "gct,gdm7243-timer";
        reg = <0xfc006c40 0x20>;
        interrupts = <18>;
        clocks = <&clocks 7>;
    };
...
```
